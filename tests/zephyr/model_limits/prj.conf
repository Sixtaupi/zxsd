## CMakeLists.txt
```
cmake_minimum_required(VERSION 3.20.0)

set(ZXSD_ROOT ${CMAKE_CURRENT_LIST_DIR}/../../..)
list(APPEND EXTRA_ZEPHYR_MODULES ${ZXSD_ROOT})

find_package(Zephyr REQUIRED HINTS $ENV{ZEPHYR_BASE})
project(zxsd_model_limits_test)

target_sources(app PRIVATE src/main.c ${ZXSD_ROOT}/tests/test_model_limits.c)
target_include_directories(app PRIVATE ${ZXSD_ROOT}/src)
target_compile_definitions(app PRIVATE ZXSD_TEST_NO_MAIN=1)
```

## prj.conf
```kconfig
CONFIG_ZTEST=y
CONFIG_ZTEST_STACK_SIZE=16384
CONFIG_ZXSD=y
CONFIG_ZXSD_STREAM_MODEL_CAPACITY=8
CONFIG_ZXSD_MAX_DEPTH=8
CONFIG_ZXSD_MAX_PARTICLES=4
CONFIG_ZXSD_MAX_ATTRIBUTES=2
CONFIG_ZXSD_MAX_TEXT_LENGTH=32
CONFIG_ZXSD_STREAM_NAME_CAPACITY=64
CONFIG_ZXSD_STREAM_CHILD_CAPACITY=1
```

## src/main.c
```c
/*
 * Copyright (c) 2026 zxsd contributors
 *
 * SPDX-License-Identifier: Apache-2.0
 */

/** @file @brief Zephyr wrapper for the shared pool-boundary tests. */

#include <zephyr/ztest.h>

extern int zxsd_test_model_limits(void);

ZTEST(zxsd_model_limits, test_model_limits)
{
	zassert_equal(zxsd_test_model_limits(), 0, "shared model pool boundary failure");
}

ZTEST_SUITE(zxsd_model_limits, NULL, NULL, NULL, NULL, NULL);
```

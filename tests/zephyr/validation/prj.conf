## CMakeLists.txt
```
cmake_minimum_required(VERSION 3.20.0)

set(ZXSD_ROOT ${CMAKE_CURRENT_LIST_DIR}/../../..)
list(APPEND EXTRA_ZEPHYR_MODULES ${ZXSD_ROOT})

find_package(Zephyr REQUIRED HINTS $ENV{ZEPHYR_BASE})
project(zxsd_zephyr_validation_test)

include(${ZXSD_ROOT}/cmake/zxsdGenerate.cmake)

set(ZXSD_TEST_ROOT ${ZXSD_ROOT}/tests)
target_sources(app PRIVATE
  src/main.c
  ${ZXSD_TEST_ROOT}/test_compatibility.c
  ${ZXSD_TEST_ROOT}/test_runtime.c
  ${ZXSD_TEST_ROOT}/test_advanced.c
  ${ZXSD_TEST_ROOT}/test_derivation.c
  ${ZXSD_TEST_ROOT}/test_simple_types.c
  ${ZXSD_TEST_ROOT}/test_wildcards.c
  ${ZXSD_TEST_ROOT}/test_identity.c
  ${ZXSD_TEST_ROOT}/test_composition.c
  ${ZXSD_TEST_ROOT}/test_element_semantics.c
  ${ZXSD_TEST_ROOT}/test_groups.c
  ${ZXSD_TEST_ROOT}/test_stream_models.c
  ${ZXSD_TEST_ROOT}/test_mixed_any.c
  ${ZXSD_TEST_ROOT}/test_recursive.c
  ${ZXSD_TEST_ROOT}/test_regex.c
  ${ZXSD_TEST_ROOT}/test_notation.c
  ${ZXSD_TEST_ROOT}/test_declarations.c
  ${ZXSD_TEST_ROOT}/test_bindings.c
  ${ZXSD_TEST_ROOT}/test_stream_bindings.c
  ${ZXSD_TEST_ROOT}/test_weather_binding.c
  ${ZXSD_ROOT}/samples/zephyr/weather/src/weather_summary.c)
target_include_directories(app PRIVATE ${ZXSD_ROOT}/samples/zephyr/weather/src)
target_compile_definitions(app PRIVATE ZXSD_TEST_NO_MAIN=1)

zxsd_generate(TARGET app SCHEMA ${ZXSD_TEST_ROOT}/device.xsd)
zxsd_generate(TARGET app SCHEMA ${ZXSD_TEST_ROOT}/advanced.xsd)
zxsd_generate(TARGET app SCHEMA ${ZXSD_TEST_ROOT}/derivation.xsd)
zxsd_generate(TARGET app SCHEMA ${ZXSD_TEST_ROOT}/simple_types.xsd)
zxsd_generate(TARGET app SCHEMA ${ZXSD_TEST_ROOT}/wildcards.xsd)
zxsd_generate(TARGET app SCHEMA ${ZXSD_TEST_ROOT}/identity.xsd)
zxsd_generate(
  TARGET app
  SCHEMA ${ZXSD_TEST_ROOT}/composition.xsd
  DEPENDS
    ${ZXSD_TEST_ROOT}/composition_include.xsd
    ${ZXSD_TEST_ROOT}/composition_foreign.xsd
    ${ZXSD_TEST_ROOT}/composition_base.xsd)
zxsd_generate(TARGET app SCHEMA ${ZXSD_TEST_ROOT}/element_semantics.xsd)
zxsd_generate(TARGET app SCHEMA ${ZXSD_TEST_ROOT}/groups.xsd)
zxsd_generate(TARGET app SCHEMA ${ZXSD_TEST_ROOT}/stream_models.xsd)
zxsd_generate(TARGET app SCHEMA ${ZXSD_TEST_ROOT}/mixed_any.xsd)
zxsd_generate(TARGET app SCHEMA ${ZXSD_TEST_ROOT}/recursive.xsd)
zxsd_generate(TARGET app SCHEMA ${ZXSD_TEST_ROOT}/regex.xsd)
zxsd_generate(
  TARGET app
  SCHEMA ${ZXSD_TEST_ROOT}/notation.xsd
  DEPENDS ${ZXSD_TEST_ROOT}/notation_formats.xsd)
zxsd_generate(TARGET app SCHEMA ${ZXSD_TEST_ROOT}/declarations.xsd)
zxsd_generate(TARGET app SCHEMA ${ZXSD_TEST_ROOT}/bindings.xsd BINDINGS)
zxsd_generate(TARGET app SCHEMA ${ZXSD_TEST_ROOT}/stream_bindings.xsd
  BINDINGS BIND_ROOT row STREAM_BIND doc/row doc/row/label row uniqueDoc/row)
zxsd_generate(TARGET app SCHEMA ${ZXSD_ROOT}/samples/zephyr/weather/met_weather.xsd
  STREAM_BIND weatherdata/product/time)
```

## prj.conf
```kconfig
CONFIG_ZTEST=y
# Streaming state and the bounded regex workspace both live on the ztest thread
# stack. Keep their complete default workspace available in validation tests.
CONFIG_ZTEST_STACK_SIZE=131072
# The shared identity and binding tests deliberately inject malloc/free as an
# application-owned scratch allocator. This heap belongs to the test harness;
# CONFIG_ZXSD_NO_HEAP still prevents implicit allocation by the runtime.
CONFIG_COMMON_LIBC_MALLOC_ARENA_SIZE=524288

CONFIG_ZXSD=y
CONFIG_ZXSD_NO_HEAP=y
CONFIG_ZXSD_BINDINGS=y
CONFIG_ZXSD_MAX_INPUT=8192
CONFIG_ZXSD_MAX_IDENTITY_VALUES=8
CONFIG_ZXSD_MAX_TEXT_LENGTH=128
```

## src/main.c
```c
/*
 * Copyright (c) 2026 Sixtaupi
 *
 * SPDX-License-Identifier: Apache-2.0
 */

/** @file @brief Zephyr wrappers for the shared portable C test entry points. */

#include <zephyr/ztest.h>

extern int zxsd_test_compatibility(void);

extern int zxsd_test_runtime(void);
extern int zxsd_test_advanced(void);
extern int zxsd_test_derivation(void);
extern int zxsd_test_simple_types(void);
extern int zxsd_test_wildcards(void);
extern int zxsd_test_identity(void);
extern int zxsd_test_composition(void);
extern int zxsd_test_element_semantics(void);
extern int zxsd_test_groups(void);
extern int zxsd_test_stream_models(void);
extern int zxsd_test_mixed_any(void);
extern int zxsd_test_recursive(void);
extern int zxsd_test_regex(void);
extern int zxsd_test_notation(void);
extern int zxsd_test_declarations(void);
extern int zxsd_test_bindings(void);
extern int zxsd_test_stream_bindings(void);
extern int zxsd_test_weather_binding(void);

#define ZXSD_RUN(entry) zassert_equal(entry(), 0, #entry " failed")

ZTEST(zxsd_validation, test_compatibility)
{
	ZXSD_RUN(zxsd_test_compatibility);
}

ZTEST(zxsd_validation, test_runtime)
{
	ZXSD_RUN(zxsd_test_runtime);
}

ZTEST(zxsd_validation, test_advanced)
{
	ZXSD_RUN(zxsd_test_advanced);
}

ZTEST(zxsd_validation, test_derivation)
{
	ZXSD_RUN(zxsd_test_derivation);
}

ZTEST(zxsd_validation, test_simple_types)
{
	ZXSD_RUN(zxsd_test_simple_types);
}

ZTEST(zxsd_validation, test_wildcards)
{
	ZXSD_RUN(zxsd_test_wildcards);
}

ZTEST(zxsd_validation, test_identity)
{
	ZXSD_RUN(zxsd_test_identity);
}

ZTEST(zxsd_validation, test_composition)
{
	ZXSD_RUN(zxsd_test_composition);
}

ZTEST(zxsd_validation, test_element_semantics)
{
	ZXSD_RUN(zxsd_test_element_semantics);
}

ZTEST(zxsd_validation, test_groups)
{
	ZXSD_RUN(zxsd_test_groups);
}

ZTEST(zxsd_validation, test_stream_models)
{
	ZXSD_RUN(zxsd_test_stream_models);
}

ZTEST(zxsd_validation, test_mixed_any)
{
	ZXSD_RUN(zxsd_test_mixed_any);
}

ZTEST(zxsd_validation, test_recursive)
{
	ZXSD_RUN(zxsd_test_recursive);
}

ZTEST(zxsd_validation, test_regex)
{
	ZXSD_RUN(zxsd_test_regex);
}

ZTEST(zxsd_validation, test_notation)
{
	ZXSD_RUN(zxsd_test_notation);
}

ZTEST(zxsd_validation, test_declarations)
{
	ZXSD_RUN(zxsd_test_declarations);
}

ZTEST(zxsd_validation, test_bindings)
{
	ZXSD_RUN(zxsd_test_bindings);
}

ZTEST(zxsd_validation, test_stream_bindings)
{
	ZXSD_RUN(zxsd_test_stream_bindings);
}

ZTEST(zxsd_validation, test_weather_binding)
{
	ZXSD_RUN(zxsd_test_weather_binding);
}

ZTEST_SUITE(zxsd_validation, NULL, NULL, NULL, NULL, NULL);
```

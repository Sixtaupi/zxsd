## samples/zephyr/sample.yaml
```yaml
sample:
  name: mxsd validation
tests:
  mxsd.validation:
    tags: xml validation
    platform_allow:
      - qemu_x86
```

## tests/zephyr/model_limits/testcase.yaml
```yaml
tests:
  zxsd.model_limits:
    tags:
      - zxsd
      - validation
    platform_allow:
      - qemu_x86
      - qemu_cortex_a53
    integration_platforms:
      - qemu_x86
    harness: ztest
```

## tests/zephyr/validation/testcase.yaml
```yaml
common:
  tags:
    - xml
    - validation
  platform_allow:
    - qemu_x86
  integration_platforms:
    - qemu_x86
  harness: ztest
tests:
  zxsd.validation: {}
  zxsd.validation.compact:
    extra_configs:
      - CONFIG_ZXSD_STREAM_CHILD_CAPACITY=1
  zxsd.validation.history:
    extra_configs:
      - CONFIG_ZXSD_STREAM_MODEL_CAPACITY=0
```

## west.yml
```yaml
manifest:
  self:
    path: mxsd

  remotes:
    - name: zephyrproject-rtos
      url-base: https://github.com/zephyrproject-rtos
    - name: michaelrsweet
      url-base: https://github.com/michaelrsweet

  projects:
    - name: zephyr
      remote: zephyrproject-rtos
      revision: main
      import:
        name-allowlist:
          - cmsis_6
          - hal_nxp
    - name: mxml
      remote: michaelrsweet
      revision: v4.0.6
      path: modules/lib/mxml
```

## zephyr/Kconfig
```kconfig
# Copyright (c) 2026 Sixtaupi
# SPDX-License-Identifier: Apache-2.0

menuconfig ZXSD
	bool "zxsd XML Schema validation runtime"
	help
	  Enable the zxsd descriptor-driven XML validation runtime. XML Schema
	  files are compiled on the host and are never parsed on the target.

if ZXSD

config ZXSD_MAX_INPUT
	int "Maximum XML input size"
	default 1048576
	range 1 2147483647
	help
	  Maximum size, in bytes, of a NUL-terminated XML document accepted by
	  the validator. Documents larger than this value produce
	  ZXSD_ERR_INPUT_TOO_LARGE.

config ZXSD_MAX_DEPTH
	int "Maximum XML nesting depth"
	default 32
	range 1 256
	help
	  Maximum number of nested XML elements. Lower values reduce the worst-case
	  stack usage of the allocation-free parser.

config ZXSD_MAX_PARTICLES
	int "Maximum particles per complex type"
	default 32
	range 1 256
	help
	  Maximum number of element particles accepted in one generated complex
	  type. The runtime keeps one occurrence counter and one pointer-table entry
	  per distinct particle on each active streaming frame.

config ZXSD_MAX_ATTRIBUTES
	int "Maximum attributes per element"
	default 32
	range 1 256
	help
	  Maximum number of non-namespace attributes accepted on one XML element.
	  The same limit applies to generated attribute descriptors.

config ZXSD_MAX_NAMESPACES
	int "Maximum active namespace bindings"
	default 16
	range 1 256
	help
	  Maximum number of namespace declarations simultaneously visible while
	  validating a document.

config ZXSD_MAX_IDENTITY_VALUES
	int "Maximum identity values per constraint"
	default 64
	range 1 4096
	help
	  Maximum key, unique, or keyref tuples retained for one constraint.

config ZXSD_MAX_TEXT_LENGTH
	int "Maximum text value length"
	default 1024
	range 1 1048576
	help
	  Maximum decoded lexical value length and per-frame streaming text buffer.

config ZXSD_STREAM_CHILD_CAPACITY
	int "Maximum child history per streamed element"
	default 64
	range 1 65536
	help
	  Maximum child tokens retained when the nested-model pool is disabled,
	  or for hand-built particle trees outside the incremental subset.
	  Incremental models do not consume this capacity. History storage is
	  reserved for every configured XML nesting level.

config ZXSD_STREAM_MODEL_CAPACITY
	int "Shared nested content-model continuation slots"
	default 128
	range 0 4096
	help
	  Fixed continuation/frontier pool shared by all open XML elements.
	  Handles nested sequences, choices and ambiguous repetition partitions
	  without retaining child history. Exhaustion reports ZXSD_ERR_STREAM_LIMIT.
	  Zero disables this interpreter and uses bounded child history instead.
	  Flat content models always keep their counter-based fast path.

config ZXSD_STREAM_NAME_CAPACITY
	int "Streaming name and namespace storage"
	default 128
	range 1 4096
	help
	  Bytes retained for one local name, namespace URI, or namespace prefix,
	  including its terminating NUL. Configure enough storage for schema names
	  and URIs as well as the prefixes accepted from input documents.

config ZXSD_XML_TOKEN_CAPACITY
	int "Maximum incomplete XML token size"
	default 4096
	range 64 1048576
	help
	  Maximum bytes retained when a raw XML fragment ends inside a tag,
	  comment, processing instruction, or CDATA section.

config ZXSD_MAX_PATTERN_LENGTH
	int "Maximum XSD regular-expression length"
	default 256
	range 1 4096
	help
	  Maximum UTF-8 byte length of one generated pattern expression.

config ZXSD_MAX_REGEX_NODES
	int "Maximum regular-expression nodes"
	default 512
	range 16 4096
	help
	  Fixed parser capacity used while validating a pattern-constrained value.

config ZXSD_MAX_REGEX_DEPTH
	int "Maximum regular-expression nesting depth"
	default 32
	range 1 256
	help
	  Maximum nesting of groups and character-class subtraction.

config ZXSD_MAX_SCHEMA_COMPLEXITY
	int "Maximum runtime schema complexity"
	default 4096
	range 1 1048576
	help
	  Maximum aggregate count of runtime-visible schema descriptors.

config ZXSD_BINDINGS
	bool "Typed data bindings"
	help
	  Build the reader and writer used by structures generated with
	  zxsdc --bindings. Reading needs a caller-provided arena and never uses
	  the heap; writing streams to a caller-provided sink.

config ZXSD_NO_HEAP
	bool "Disable runtime heap allocation"
	default y
	help
	  Build a zero-heap validator. Schemas using identity constraints return
	  ZXSD_ERR_RESOURCE_LIMIT; all other supported validation stays available.

endif # ZXSD
```

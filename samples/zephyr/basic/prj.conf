## CMakeLists.txt
```
cmake_minimum_required(VERSION 3.20.0)

set(MXSD_ROOT ${CMAKE_CURRENT_LIST_DIR}/../../..)
# Preserve modules discovered by west (including board HALs) while also
# allowing this sample to be built from a standalone mxsd checkout.
list(APPEND EXTRA_ZEPHYR_MODULES ${MXSD_ROOT})

find_package(Zephyr REQUIRED HINTS $ENV{ZEPHYR_BASE})
project(mxsd_zephyr_test)

find_package(Python3 REQUIRED COMPONENTS Interpreter)
set(MXSD_GEN ${CMAKE_CURRENT_BINARY_DIR}/generated)
file(MAKE_DIRECTORY ${MXSD_GEN})
execute_process(
  COMMAND ${Python3_EXECUTABLE} ${MXSD_ROOT}/mxsdc ${MXSD_ROOT}/tests/device.xsd -o ${MXSD_GEN}
  COMMAND_ERROR_IS_FATAL ANY)
target_sources(app PRIVATE src/main.c ${MXSD_GEN}/device.mxsd.c)
target_include_directories(app PRIVATE ${MXSD_GEN})
```

## prj.conf
```kconfig
CONFIG_ZTEST=y
# The default complete-regex workspace is bounded but intentionally lives on
# the caller's stack. Applications that lower CONFIG_MXSD_MAX_REGEX_NODES can
# lower this value after measuring their own schemas. ZTEST cases run on the
# ztest thread, so its stack must hold the workspace, not the main stack.
CONFIG_ZTEST_STACK_SIZE=16384
CONFIG_MXSD=y
```

## src/main.c
```c
/*
 * Copyright (c) 2026 Romain Pelletant
 *
 * SPDX-License-Identifier: Apache-2.0
 */

/**
 * @file
 * @brief Zephyr ztest coverage for the mxsd runtime.
 */

#include <zephyr/ztest.h>
#include "device.mxsd.h"

/** Verify that a schema-conforming document is accepted. */
ZTEST(mxsd, test_valid_document)
{
	mxsd_result_t r =
		device_validate("<device id='7'><name>node</name><sample>1</sample></device>");
	zassert_equal(r.code, MXSD_OK, "validation failed: %s", r.message);
}

/** Verify that a document missing a required element is rejected. */
ZTEST(mxsd, test_invalid_document)
{
	mxsd_result_t r = device_validate("<device id='7'><name>node</name></device>");
	zassert_equal(r.code, MXSD_ERR_MISSING_ELEMENT, "unexpected result: %s", r.message);
}

/** Register the mxsd validation test suite. */
ZTEST_SUITE(mxsd, NULL, NULL, NULL, NULL, NULL);
```

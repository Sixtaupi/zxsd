## CMakeLists.txt
```
cmake_minimum_required(VERSION 3.20.0)

set(ZXSD_ROOT ${CMAKE_CURRENT_LIST_DIR}/../../..)
# Preserve modules discovered by west (including board HALs) while also
# allowing this sample to be built from a standalone zxsd checkout.
list(APPEND EXTRA_ZEPHYR_MODULES ${ZXSD_ROOT})

find_package(Zephyr REQUIRED HINTS $ENV{ZEPHYR_BASE})
project(zxsd_zephyr_rest)

include(${ZXSD_ROOT}/cmake/zxsdGenerate.cmake)

target_sources(app PRIVATE src/main.c)
zxsd_generate(TARGET app SCHEMA slideshow.xsd BINDINGS)
```

## sample.yaml
```
sample:
  name: mxsd REST XML client
  description: Exchange validated XML with a REST API using generated typed bindings
tests:
  mxsd.rest.build:
    tags: xml bindings net http
    build_only: true
    platform_allow:
      - qemu_x86
    integration_platforms:
      - qemu_x86
```

## prj.conf
```kconfig
CONFIG_ZXSD=y
CONFIG_ZXSD_BINDINGS=y
CONFIG_ZXSD_MAX_INPUT=256
CONFIG_ZXSD_MAX_TEXT_LENGTH=128
CONFIG_ZXSD_NO_HEAP=y

CONFIG_NETWORKING=y
CONFIG_NET_IPV4=y
CONFIG_NET_IPV6=n
CONFIG_NET_TCP=y
CONFIG_NET_SOCKETS=y
CONFIG_DNS_RESOLVER=y
CONFIG_HTTP_CLIENT=y
CONFIG_NET_CONNECTION_MANAGER=y
CONFIG_NET_MGMT=y
CONFIG_NET_MGMT_EVENT=y
CONFIG_NET_MGMT_EVENT_INFO=y
CONFIG_NET_CONFIG_SETTINGS=y
CONFIG_NET_CONFIG_NEED_IPV4=y
CONFIG_NET_CONFIG_AUTO_INIT=y
CONFIG_NET_DHCPV4=y

CONFIG_MAIN_STACK_SIZE=16384
CONFIG_HW_STACK_PROTECTION=y
```

## overlay-nsos.conf
```kconfig
# Use the Linux host sockets directly when running on native_sim.
CONFIG_ETH_NATIVE_TAP=n
CONFIG_NET_DRIVERS=y
CONFIG_NET_SOCKETS_OFFLOAD=y
CONFIG_NET_NATIVE_OFFLOADED_SOCKETS=y

# Address assignment belongs to Docker/the host with socket offloading.
CONFIG_NET_CONFIG_AUTO_INIT=n
CONFIG_NET_CONFIG_NEED_IPV4=n
CONFIG_NET_DHCPV4=n

# Native socket offload does not receive DNS servers through Zephyr DHCP.
# Configure one for the allocation-free Zephyr DNS resolver.
CONFIG_DNS_SERVER_IP_ADDRESSES=y
CONFIG_DNS_SERVER1="1.1.1.1"
```

## src/main.c
```c
/*
 * Copyright (c) 2026 Sixtaupi
 *
 * SPDX-License-Identifier: Apache-2.0
 */

/**
 * @file
 * @brief REST client exchanging validated XML through generated bindings.
 */

#include <zephyr/kernel.h>
#include <zephyr/net/dns_resolve.h>
#include <zephyr/net/http/client.h>
#include <zephyr/net/net_ip.h>
#include <zephyr/net/socket.h>

#include <errno.h>
#include <string.h>

#include "slideshow.bind.h"

#define REST_HOST    "httpbin.org"
#define REST_PORT    80
#define HTTP_TIMEOUT (15 * MSEC_PER_SEC)
#define XML_RESOURCE_URL                                                                           \
	"/base64/PHNsaWRlc2hvdyB0aXRsZT0iWmVwaHlyIFJFU1QgZGVtbyIgZGF0ZT0iMjAyNi0xMC0yMSIg"         \
	"YXV0aG9yPSJodHRwYmluIj48c2xpZGUgdHlwZT0iYWxsIj48dGl0bGU+VmFsaWRhdGVkIFhNTDwvdGl0"         \
	"bGU+PGl0ZW0+UmVhZDwvaXRlbT48aXRlbT5VcGRhdGU8L2l0ZW0+PGl0ZW0+V3JpdGU8L2l0ZW0+PC9z"         \
	"bGlkZT48L3NsaWRlc2hvdz4="

/** Complete XML response body and the HTTP status collected by the callback. */
struct response_body {
	char *data;
	size_t capacity;
	size_t length;
	int status;
	bool overflow;
};

static char http_receive_buffer[2048];
static char xml[2048];
static char response_storage[2048];
static unsigned char arena_storage[1024];

BUILD_ASSERT(CONFIG_HEAP_MEM_POOL_SIZE == 0,
	     "the REST sample must keep the Zephyr system heap disabled");

/** Caller-owned result of one asynchronous, allocation-free DNS query. */
struct resolve_state {
	struct k_sem done;
	struct sockaddr_in address;
	int status;
	bool found;
};

/** Collect body fragments because Zephyr may invoke the callback more than once. */
static int response_cb(struct http_response *response, enum http_final_call final_data,
		       void *user_data)
{
	struct response_body *body = user_data;
	size_t available;
	size_t copied;

	body->status = response->http_status_code;
	if (response->body_frag_start == NULL || response->body_frag_len == 0u) {
		return 0;
	}
	available = body->capacity - body->length - 1u;
	copied = MIN(response->body_frag_len, available);
	memcpy(body->data + body->length, response->body_frag_start, copied);
	body->length += copied;
	body->data[body->length] = '\0';
	body->overflow |= copied != response->body_frag_len;
	ARG_UNUSED(final_data);
	return 0;
}

/** Retain the first IPv4 result and signal when the DNS query is complete. */
static void resolve_cb(enum dns_resolve_status status, struct dns_addrinfo *info, void *user_data)
{
	struct resolve_state *state = user_data;

	if (status == DNS_EAI_INPROGRESS && info != NULL && info->ai_family == AF_INET &&
	    info->ai_addrlen == sizeof(state->address) && !state->found) {
		memcpy(&state->address, &info->ai_addr_storage, sizeof(state->address));
		state->found = true;
		return;
	}
	if (status == DNS_EAI_INPROGRESS) {
		return;
	}
	state->status = status == DNS_EAI_ALLDONE && state->found ? 0 : status;
	k_sem_give(&state->done);
}

/** Resolve the REST host through Zephyr's fixed DNS query and buffer pools. */
static int resolve_service(struct sockaddr_in *address)
{
	struct resolve_state state = {0};
	uint16_t dns_id;
	int rc;

	k_sem_init(&state.done, 0, 1);
	state.status = DNS_EAI_FAIL;
	rc = dns_get_addr_info(REST_HOST, DNS_QUERY_TYPE_A, &dns_id, resolve_cb, &state,
			       HTTP_TIMEOUT);
	if (rc != 0) {
		return rc;
	}
	k_sem_take(&state.done, K_FOREVER);
	if (state.status != 0) {
		return state.status;
	}
	state.address.sin_port = htons(REST_PORT);
	*address = state.address;
	return 0;
}

/** Open one TCP connection to the configured REST service. */
static int connect_service(void)
{
	struct sockaddr_in address;
	int client;
	int rc;

	rc = resolve_service(&address);
	if (rc != 0) {
		printk("DNS failed: %d\n", rc);
		return -EHOSTUNREACH;
	}
	client = zsock_socket(AF_INET, SOCK_STREAM, IPPROTO_TCP);
	if (client >= 0 &&
	    zsock_connect(client, (const struct sockaddr *)&address, sizeof(address)) < 0) {
		rc = -errno;
		zsock_close(client);
		client = rc;
	} else if (client < 0) {
		client = -errno;
	}
	return client;
}

/** Execute an HTTP request and collect its response body. */
static int request(enum http_method method, const char *url, const char *payload,
		   size_t payload_length, struct response_body *response)
{
	static const char *headers[] = {"Accept: application/xml\r\n", NULL};
	struct http_request request = {
		.method = method,
		.url = url,
		.host = REST_HOST,
		.protocol = "HTTP/1.1",
		.header_fields = headers,
		.content_type_value = "application/xml",
		.payload = payload,
		.payload_len = payload_length,
		.response = response_cb,
		.recv_buf = http_receive_buffer,
		.recv_buf_len = sizeof(http_receive_buffer),
	};
	int client;
	int rc;

	client = connect_service();
	if (client < 0) {
		return client;
	}
	rc = http_client_req(client, &request, HTTP_TIMEOUT, response);
	zsock_close(client);
	return rc;
}

int main(void)
{
	struct response_body response = {.data = xml, .capacity = sizeof(xml)};
	slideshow_slideshow_t slideshow;
	zxsd_bind_arena_t arena;
	zxsd_result_t result;
	size_t xml_length;
	int rc;

	/* GET a REST resource whose response body is XML. */
	rc = request(HTTP_GET, XML_RESOURCE_URL, NULL, 0u, &response);
	if (rc < 0 || response.status != 200 || response.overflow) {
		printk("GET failed: transport %d, HTTP %d, overflow %d\n", rc, response.status,
		       response.overflow);
		return 0;
	}

	printk("GET XML response body: %.*s", (int)response.length, response.data);

	/* read() validates against slideshow.xsd before exposing typed values. */
	zxsd_bind_arena_init(&arena, arena_storage, sizeof(arena_storage));
	result = slideshow_slideshow_read(xml, &slideshow, &arena);
	if (result.code != ZXSD_OK) {
		printk("GET XML rejected: %s at %u\n", result.message, (unsigned int)result.offset);
		return 0;
	}
	printk("GET XML valid: \"%s\", %u slide(s)\n", slideshow.title,
	       (unsigned int)slideshow.slide_count);

	/* Modify the typed resource, then serialize and validate it before sending. */
	slideshow.author = "zxsd on Zephyr";
	result = slideshow_slideshow_write_buffer(&slideshow, xml, sizeof(xml), &xml_length);
	if (result.code != ZXSD_OK) {
		printk("serialization refused: %s\n", result.message);
		return 0;
	}
	printk("POST XML valid: %u bytes\n", (unsigned int)xml_length);

	/* httpbin accepts the XML entity and returns a JSON diagnostic envelope. */
	response = (struct response_body){.data = response_storage,
					  .capacity = sizeof(response_storage)};
	rc = request(HTTP_POST, "/anything", xml, xml_length, &response);
	if (rc < 0 || response.status != 200) {
		printk("POST failed: transport %d, HTTP %d\n", rc, response.status);
		return 0;
	}
	printk("POST accepted: HTTP %d\n", response.status);
	printk("zxsd REST sample done\n");
	return 0;
}
```

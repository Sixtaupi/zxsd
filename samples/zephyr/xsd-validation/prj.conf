## CMakeLists.txt
```
cmake_minimum_required(VERSION 3.20.0)

set(ZXSD_ROOT ${CMAKE_CURRENT_LIST_DIR}/../../..)
# Preserve modules discovered by west (including board HALs) while also
# allowing this sample to be built from a standalone zxsd checkout.
list(APPEND EXTRA_ZEPHYR_MODULES ${ZXSD_ROOT})

find_package(Zephyr REQUIRED HINTS $ENV{ZEPHYR_BASE})
project(zxsd_zephyr_xsd_validation)

include(${ZXSD_ROOT}/cmake/zxsdGenerate.cmake)

target_sources(app PRIVATE src/main.c)
zxsd_generate(TARGET app SCHEMA device.xsd ZEPHYR_CONFIG)
```

## sample.yaml
```
sample:
  name: zxsd XSD validation
  description: Validate XML documents against a schema compiled on the build host
tests:
  zxsd.xsd_validation:
    tags: 
      - xml
      - validation
    platform_allow:
      - qemu_x86
    integration_platforms:
      - qemu_x86
    harness: console
    harness_config:
      type: multi_line
      ordered: true
      regex:
        - "valid document: valid"
        - "invalid document: invalid, missing required element \\(device\\)"
        - "zxsd XSD validation sample done"
```

## prj.conf
```kconfig
CONFIG_ZXSD=y

# Schema-derived limits, reviewed from the output of:
#   python3 zxsdc device.xsd -o generated --zephyr-config
# zxsd_generate(... ZEPHYR_CONFIG) regenerates the matching checks at build
# time: compilation fails if a value drops below what device.xsd requires.
CONFIG_ZXSD_MAX_ATTRIBUTES=1
CONFIG_ZXSD_MAX_DEPTH=2
CONFIG_ZXSD_MAX_PARTICLES=3
CONFIG_ZXSD_MAX_PATTERN_LENGTH=1
CONFIG_ZXSD_MAX_REGEX_DEPTH=1
CONFIG_ZXSD_MAX_REGEX_NODES=16
CONFIG_ZXSD_MAX_SCHEMA_COMPLEXITY=10
CONFIG_ZXSD_STREAM_CHILD_CAPACITY=1
CONFIG_ZXSD_STREAM_MODEL_CAPACITY=0
CONFIG_ZXSD_STREAM_NAME_CAPACITY=42

# Application budgets, which the XSD cannot bound. Validation keeps per-level
# text buffers sized by CONFIG_ZXSD_MAX_TEXT_LENGTH on the stack.
CONFIG_ZXSD_MAX_INPUT=256
CONFIG_ZXSD_MAX_TEXT_LENGTH=128

# The bounded validation workspace lives on the main thread stack. This size
# is a conservative default; measure with CONFIG_INIT_STACKS before lowering it.
CONFIG_MAIN_STACK_SIZE=16384
# Turn a stack overflow into an immediate fault instead of silent corruption.
CONFIG_HW_STACK_PROTECTION=y
```

## src/main.c
```c
/*
 * Copyright (c) 2026 Sixtaupi
 *
 * SPDX-License-Identifier: Apache-2.0
 */

/**
 * @file
 * @brief Validate XML documents against a schema compiled on the build host.
 *
 * device.xsd is converted to C descriptors at build time, so the target only
 * links the generated validator and the zxsd runtime. No heap is used.
 */

#include <zephyr/kernel.h>

#include "device.zxsd.h"

/** Document that conforms to device.xsd. */
static const char valid_document[] = "<device id='7'>"
				     "<name>node</name>"
				     "<enabled>true</enabled>"
				     "<sample>21</sample>"
				     "<sample>-4</sample>"
				     "</device>";

/** Document that lacks the required sample element. */
static const char invalid_document[] = "<device id='7'><name>node</name></device>";

/** Validate one document and print the outcome. */
static void validate(const char *label, const char *xml)
{
	zxsd_result_t result = device_validate(xml);

	if (result.code == ZXSD_OK) {
		printk("%s: valid\n", label);
		return;
	}

	printk("%s: invalid, %s", label, result.message);
	if (result.path != NULL) {
		printk(" (%s)", result.path);
	}
	printk(" at offset %u\n", (unsigned int)result.offset);
}

int main(void)
{
	validate("valid document", valid_document);
	validate("invalid document", invalid_document);
	printk("zxsd XSD validation sample done\n");

	return 0;
}
```

## CMakeLists.txt
```
cmake_minimum_required(VERSION 3.20.0)

set(ZXSD_ROOT ${CMAKE_CURRENT_LIST_DIR}/../../..)
# Preserve modules discovered by west (including board HALs) while also
# allowing this sample to be built from a standalone zxsd checkout.
list(APPEND EXTRA_ZEPHYR_MODULES ${ZXSD_ROOT})

find_package(Zephyr REQUIRED HINTS $ENV{ZEPHYR_BASE})
project(zxsd_zephyr_xsd_validation_mxml)

include(${ZXSD_ROOT}/cmake/zxsdGenerate.cmake)

target_sources(app PRIVATE src/main.c)
zxsd_generate(TARGET app SCHEMA device.xsd ZEPHYR_CONFIG)
```

## sample.yaml
```
sample:
  name: zxsd Mini-XML validation
  description: Validate Mini-XML trees against a schema compiled on the build host
tests:
  zxsd.xsd_validation_mxml:
    tags:
      - xml
      - validation
    # Skipped when no Mini-XML Zephyr module is present in the workspace.
    modules:
      - mxml
    platform_allow:
      - qemu_x86
    integration_platforms:
      - qemu_x86
    harness: console
    harness_config:
      type: multi_line
      ordered: true
      regex:
        - "valid document: valid"
        - "invalid document: invalid, incorrect element order \\(device\\)"
        - "zxsd Mini-XML validation sample done"
```

## prj.conf
```kconfig
CONFIG_ZXSD=y

# Provided by the Mini-XML 4 Zephyr module. Enabling it selects the zxsd
# Mini-XML backend and enables the libc allocator that Mini-XML needs.
CONFIG_MXML=y
# Mini-XML allocates its options, nodes, and strings from this arena. Size it
# for the largest document parsed at once.
CONFIG_COMMON_LIBC_MALLOC_ARENA_SIZE=4096

# Schema-derived limits, reviewed from the output of:
#   python3 zxsdc device.xsd -o generated --zephyr-config
# zxsd_generate(... ZEPHYR_CONFIG) regenerates the matching checks at build
# time: compilation fails if a value drops below what device.xsd requires.
CONFIG_ZXSD_MAX_ATTRIBUTES=1
CONFIG_ZXSD_MAX_DEPTH=2
CONFIG_ZXSD_MAX_PARTICLES=3
CONFIG_ZXSD_MAX_PATTERN_LENGTH=1
CONFIG_ZXSD_MAX_REGEX_DEPTH=1
CONFIG_ZXSD_MAX_REGEX_NODES=16
CONFIG_ZXSD_MAX_SCHEMA_COMPLEXITY=10
CONFIG_ZXSD_STREAM_CHILD_CAPACITY=1
CONFIG_ZXSD_STREAM_MODEL_CAPACITY=0
CONFIG_ZXSD_STREAM_NAME_CAPACITY=42

# Application budgets, which the XSD cannot bound. Validation keeps per-level
# text buffers sized by CONFIG_ZXSD_MAX_TEXT_LENGTH on the stack.
CONFIG_ZXSD_MAX_INPUT=256
CONFIG_ZXSD_MAX_TEXT_LENGTH=128

# The bounded validation workspace lives on the main thread stack. This size
# is a conservative default; measure with CONFIG_INIT_STACKS before lowering it.
CONFIG_MAIN_STACK_SIZE=16384
# Turn a stack overflow into an immediate fault instead of silent corruption.
CONFIG_HW_STACK_PROTECTION=y
```

## src/main.c
```c
/*
 * Copyright (c) 2026 Sixtaupi
 *
 * SPDX-License-Identifier: Apache-2.0
 */

/**
 * @file
 * @brief Validate Mini-XML trees against a schema compiled on the build host.
 *
 * The application parses XML with Mini-XML, then validates the resulting tree
 * with the zxsd Mini-XML adapter and the descriptors generated from device.xsd.
 * Mini-XML allocates the tree from the libc heap; zxsd validation does not
 * allocate.
 */

#include <zephyr/kernel.h>

#include <zxsd_mxml.h>

#include "device.zxsd.h"

/** Document that conforms to device.xsd. */
static const char valid_document[] = "<device id='7'>"
				     "<name>node</name>"
				     "<enabled>true</enabled>"
				     "<sample>21</sample>"
				     "<sample>-4</sample>"
				     "</device>";

/** Document that lacks the required sample element. */
static const char invalid_document[] = "<device id='7'><name>node</name></device>";

/** Print the outcome of one validation. */
static void print_result(const char *label, zxsd_result_t result)
{
	if (result.code == ZXSD_OK) {
		printk("%s: valid\n", label);
		return;
	}

	printk("%s: invalid, %s", label, result.message);
	if (result.path != NULL) {
		printk(" (%s)", result.path);
	}
	printk(" at offset %u\n", (unsigned int)result.offset);
}

/** Parse a document with Mini-XML, then validate the resulting tree. */
static void validate(const char *label, const char *xml)
{
	mxml_options_t *options = mxmlOptionsNew();
	mxml_node_t *document;

	if (options == NULL) {
		printk("%s: could not allocate Mini-XML options\n", label);
		return;
	}
	/* Keep text nodes intact so that zxsd sees the original character data. */
	mxmlOptionsSetTypeValue(options, MXML_TYPE_OPAQUE);
	document = mxmlLoadString(NULL, options, xml);
	mxmlOptionsDelete(options);
	if (document == NULL) {
		printk("%s: Mini-XML could not parse the document\n", label);
		return;
	}

	print_result(label, zxsd_mxml_validate(device_schema(), document));
	mxmlDelete(document);
}

int main(void)
{
	validate("valid document", valid_document);
	validate("invalid document", invalid_document);
	printk("zxsd Mini-XML validation sample done\n");

	return 0;
}
```

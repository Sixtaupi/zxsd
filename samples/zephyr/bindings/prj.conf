## CMakeLists.txt
```
cmake_minimum_required(VERSION 3.20.0)

set(ZXSD_ROOT ${CMAKE_CURRENT_LIST_DIR}/../../..)
# Preserve modules discovered by west (including board HALs) while also
# allowing this sample to be built from a standalone zxsd checkout.
list(APPEND EXTRA_ZEPHYR_MODULES ${ZXSD_ROOT})

find_package(Zephyr REQUIRED HINTS $ENV{ZEPHYR_BASE})
project(zxsd_zephyr_bindings)

include(${ZXSD_ROOT}/cmake/zxsdGenerate.cmake)

target_sources(app PRIVATE src/main.c)
zxsd_generate(TARGET app SCHEMA settings.xsd BINDINGS ZEPHYR_CONFIG)
```

## sample.yaml
```
sample:
  name: zxsd typed bindings
  description: Read, update and write XML settings through generated C structures
tests:
  zxsd.bindings:
    tags:
      - xml
      - bindings
    platform_allow:
      - qemu_x86
    integration_platforms:
      - qemu_x86
    harness: console
    harness_config:
      type: multi_line
      ordered: true
      regex:
        - "read: version 3, mode performance, 2 sensor\\(s\\)"
        - "sensor 2 \"Room & hallway humidity\": every 2000 ms, disabled"
        - "write: ok, [0-9]+ bytes"
        - "<ns1:sensor id=\"3\"><ns1:label>Outdoor pressure</ns1:label>"
        - "validate: ok"
        - "rejected: incorrect element order \\(settings\\)"
        - "refused: missing required element \\(label\\)"
        - "zxsd bindings sample done"
```

## prj.conf
```kconfig
CONFIG_ZXSD=y
CONFIG_ZXSD_BINDINGS=y

# Schema-derived limits, reviewed from the output of:
#   python3 zxsdc settings.xsd -o generated --bindings --zephyr-config
# zxsd_generate(... ZEPHYR_CONFIG) regenerates the matching checks at build
# time: compilation fails if a value drops below what settings.xsd requires.
CONFIG_ZXSD_MAX_ATTRIBUTES=2
CONFIG_ZXSD_MAX_DEPTH=3
CONFIG_ZXSD_MAX_PARTICLES=3
CONFIG_ZXSD_MAX_PATTERN_LENGTH=1
CONFIG_ZXSD_MAX_REGEX_DEPTH=1
CONFIG_ZXSD_MAX_REGEX_NODES=16
CONFIG_ZXSD_MAX_SCHEMA_COMPLEXITY=10
CONFIG_ZXSD_STREAM_CHILD_CAPACITY=1
CONFIG_ZXSD_STREAM_MODEL_CAPACITY=0
CONFIG_ZXSD_STREAM_NAME_CAPACITY=42

# Application budgets, which the XSD cannot bound. The largest validated
# document is the written output, limited by its 1024-byte buffer. Validation
# keeps per-level text buffers sized by CONFIG_ZXSD_MAX_TEXT_LENGTH on the
# stack; the longest value of this schema is 32 characters.
CONFIG_ZXSD_MAX_INPUT=1024
CONFIG_ZXSD_MAX_TEXT_LENGTH=128

# Measured peak on qemu_x86 with the default schema limits and a 128-byte text
# length: about 15.7 KiB, reached during validation. The schema-derived limits
# above lower it; measure with CONFIG_INIT_STACKS before reducing this size.
CONFIG_MAIN_STACK_SIZE=30480
# Turn a stack overflow into an immediate fault instead of silent corruption.
CONFIG_HW_STACK_PROTECTION=y
```

## src/main.c
```c
/*
 * Copyright (c) 2026 Sixtaupi
 *
 * SPDX-License-Identifier: Apache-2.0
 */

/**
 * @file
 * @brief Read, update and write XML settings through generated typed bindings.
 *
 * The application never handles XML text directly: a received document is
 * validated and converted to C structures, updated in C, and serialized again
 * into a validated document. No heap is used.
 */

#include <zephyr/kernel.h>

#include <string.h>

#include "settings.bind.h"
#include "settings.zxsd.h"
#include "settings_documents.h"

/*
 * Storage for strings and arrays produced by reading. Size it from the largest
 * accepted document; ZXSD_ERR_RESOURCE_LIMIT reports a too-small arena.
 */
static unsigned char arena_storage[512];

/** Output buffer for the serialized document, including its terminating NUL. */
static char output[1024];

/** Mode names indexed by the generated enumeration. */
static const char *const mode_names[] = {"off", "eco", "performance"};

/** Print the decoded settings. */
static void print_settings(const settings_settings_t *settings)
{
	size_t index;

	printk("read: version %u, mode %s, %u sensor(s)\n", (unsigned int)settings->version,
	       mode_names[settings->mode], (unsigned int)settings->sensor_count);
	for (index = 0u; index < settings->sensor_count; ++index) {
		const settings_Sensor_t *sensor = &settings->sensor[index];

		printk("  sensor %u \"%s\": every %u ms, %s", (unsigned int)sensor->id,
		       sensor->label, (unsigned int)sensor->period,
		       sensor->enabled ? "enabled" : "disabled");
		if (sensor->has_threshold) {
			printk(", threshold %d", (int)sensor->threshold);
		}
		printk("\n");
	}
}

int main(void)
{
	/* Arrays read from the document live in the arena; build a new one to add a sensor. */
	static settings_Sensor_t sensors[3];
	settings_settings_t settings;
	settings_settings_t rejected;
	zxsd_bind_arena_t arena;
	zxsd_bind_arena_t scratch;
	size_t length;
	zxsd_result_t result;

	/* 1. Validate the received document and convert it to C structures. */
	zxsd_bind_arena_init(&arena, arena_storage, sizeof(arena_storage));
	result = settings_settings_read(received_document, &settings, &arena);
	if (result.code != ZXSD_OK) {
		printk("read failed: %s at offset %u\n", result.message,
		       (unsigned int)result.offset);
		return 0;
	}
	print_settings(&settings);
	printk("arena: %u of %u bytes used\n", (unsigned int)arena.used,
	       (unsigned int)arena.capacity);

	/* 2. Update the settings in C: change the mode and add a sensor. */
	if (settings.sensor_count >= ARRAY_SIZE(sensors)) {
		printk("too many sensors to add one\n");
		return 0;
	}
	memcpy(sensors, settings.sensor, settings.sensor_count * sizeof(sensors[0]));
	sensors[settings.sensor_count] = (settings_Sensor_t){
		.id = 3u,
		.label = "Outdoor pressure",
		.period = 10000u,
	};
	settings.sensor = sensors;
	settings.sensor_count++;
	settings.mode = SETTINGS_MODE_ECO;
	settings.version++;

	/* 3. Serialize; the produced document is validated before it is reported as ok. */
	result = settings_settings_write_buffer(&settings, output, sizeof(output), &length);
	printk("write: %s, %u bytes\n%s\n", result.message, (unsigned int)length, output);
	if (result.code != ZXSD_OK) {
		return 0;
	}

	/*
	 * Validate the output explicitly against settings.xsd with the generated
	 * validator, as a receiver would do. The *_write_buffer() call above
	 * already performs this validation; *_write() to a sink does not unless a
	 * streaming validator is passed.
	 */
	result = settings_settings_validate(output);
	printk("validate: %s\n", result.message);

	/*
	 * 4. Invalid input is rejected by validation; the target structure is then
	 *    zeroed and the arena left unchanged, so use separate ones here.
	 */
	zxsd_bind_arena_init(&scratch, arena_storage + arena.used,
			     sizeof(arena_storage) - arena.used);
	result = settings_settings_read(invalid_document, &rejected, &scratch);
	printk("rejected: %s (%s)\n", result.message, result.path != NULL ? result.path : "-");

	/* 5. Structural mistakes in C are caught by the writer: a sensor needs a label. */
	sensors[2].label = NULL;
	result = settings_settings_write_buffer(&settings, output, sizeof(output), NULL);
	printk("refused: %s (%s)\n", result.message, result.path != NULL ? result.path : "-");

	printk("zxsd bindings sample done\n");
	return 0;
}
```

## src/settings_documents.h
```c
/*
 * Copyright (c) 2026 Sixtaupi
 *
 * SPDX-License-Identifier: Apache-2.0
 */

/**
 * @file
 * @brief XML settings documents used by the typed bindings sample.
 */

#ifndef ZXSD_BINDINGS_SETTINGS_DOCUMENTS_H
#define ZXSD_BINDINGS_SETTINGS_DOCUMENTS_H

/** Settings document as received, for instance from a network or a file. */
static const char received_document[] = "<?xml version='1.0' encoding='UTF-8'?>\n"
					"<settings xmlns='urn:zxsd:sample:settings' version='3'>\n"
					"  <mode>performance</mode>\n"
					"  <sensor id='1'>\n"
					"    <label>Boiler temperature</label>\n"
					"    <period>500</period>\n"
					"    <threshold>-20</threshold>\n"
					"  </sensor>\n"
					"  <sensor id='2' enabled='false'>\n"
					"    <label>Room &amp; hallway humidity</label>\n"
					"    <period>2000</period>\n"
					"  </sensor>\n"
					"</settings>\n";

/** Settings document with a sensor placed before the required mode element. */
static const char invalid_document[] = "<settings xmlns='urn:zxsd:sample:settings' version='4'>"
				       "<sensor id='1'><label>x</label><period>1</period></sensor>"
				       "</settings>";

#endif
```
